## apps/fishefuse/Kconfig
```kconfig
#
# For a description of the syntax of this configuration file,
# see the file kconfig-language.txt in the NuttX tools repository.
#

config APP_FISHEFUSE
	bool "APP EFUSE EXAMPLE"
	default n

if APP_FISHEFUSE

config APP_FISHEFUSE_PRIORITY
	int "fishefuse task priority"
	default 100

config APP_FISHEFUSE_STACKSIZE
	int "fishefuse stack size"
	default 2048

config APP_FISHHELLO_AUTO_START
	bool "fishefuse auto start"
	default n
	---help---
	Start the fishefuse automatically.

endif
```

## apps/fishhello/Kconfig
```kconfig
#
# For a description of the syntax of this configuration file,
# see the file kconfig-language.txt in the NuttX tools repository.
#

config APP_FISHHELLO
	bool "APP Hello World"
	default n

if APP_FISHHELLO

config APP_FISHHELLO_PRIORITY
	int "fishhello task priority"
	default 100

config APP_FISHHELLO_STACKSIZE
	int "fishhello stack size"
	default 2048

config APP_FISHHELLO_AUTO_START
	bool "fishhello auto start"
	default n
	---help---
	Start the fishdemo automatically.

endif
```

## apps/fishled/Kconfig
```kconfig
#
# For a description of the syntax of this configuration file,
# see the file kconfig-language.txt in the NuttX tools repository.
#

config APP_FISHLED
	bool "APP FISHLED"
	default n
	depends on FISHLED
	---help---
		Enable the FISHLED example

if APP_FISHLED

config APP_FISHLED_PRIORITY
	int "FISHLED task priority"
	default 100

config APP_FISHLED_STACKSIZE
	int "FISHLED stack size"
	default 2048

endif
```

## apps/fishpm/Kconfig
```kconfig
#
# For a description of the syntax of this configuration file,
# see the file kconfig-language.txt in the NuttX tools repository.
#

config APP_FISHPM
	bool "APP FISH PM"
	default n

if APP_FISHPM

config APP_FISHPM_PRIORITY
	int "fishpm task priority"
	default 100

config APP_FISHPM_STACKSIZE
	int "fishpm stack size"
	default 2048

config FISHPM_AUTO_START
	bool "fishpm auto start"
	default n
	---help---
	Start the fishpm automatically.

endif
```

## apps/fishsnshub/Kconfig
```kconfig
#
# For a description of the syntax of this configuration file,
# see the file kconfig-language.txt in the NuttX tools repository.
#

config APPS_FISHSNSHUB
	tristate "APP FISHSNSHUB"
	default n
	---help---
		Enable the \"fishsnshub\" app

if APPS_FISHSNSHUB

config APPS_FISHSNSHUB_PROGNAME
	string "Program name"
	default "fishsnshub"
	---help---
		This is the name of the program that will be use when the NSH ELF
		program is installed.

config APPS_FISHSNSHUB_PRIORITY
	int "fishsnshub client task priority"
	default 100

config APPS_FISHSNSHUB_STACKSIZE
	int "fishsnshub client stack size"
	default 2048

endif
```

## example/api_dcellsysinfo/Kconfig
```kconfig
#
# For a description of the syntax of this configuration file,
# see the file kconfig-language.txt in the NuttX tools repository.
#

config EXAMPLES_API_DCELLSYSINFO
    tristate "api dcellsysinfo example"
    default n
    ---help---
        Enable the api dcellsysinfo example

if EXAMPLES_API_DCELLSYSINFO

config EXAMPLES_API_DCELLSYSINFO_PROGNAME
    string "Program name"
    default "api_dcellsysinfo"

config EXAMPLES_API_DCELLSYSINFO_PRIORITY
    int "api dcellsysinfo task priority"
    default 100

config EXAMPLES_API_DCELLSYSINFO_STACKSIZE
    int "api dcellsysinfo stack size"
    default 2048

endif
```

## example/api_gpio/Kconfig
```kconfig
#
# For a description of the syntax of this configuration file,
# see the file kconfig-language.txt in the NuttX tools repository.
#

config EXAMPLES_API_GPIO
    tristate "api gpio example"
    default n
    depends on FRAMEWORKS
    depends on DEV_GPIO
    ---help---
        Enable the api gpio example

if EXAMPLES_API_GPIO

config EXAMPLES_API_GPIO_PROGNAME
    string "Program name"
    default "api_gpio"

config EXAMPLES_API_GPIO_PRIORITY
    int "api gpio task priority"
    default 100

config EXAMPLES_API_GPIO_STACKSIZE
    int "api gpio stack size"
    default 2048

endif
```

## example/api_iccid/Kconfig
```kconfig
#
# For a description of the syntax of this configuration file,
# see the file kconfig-language.txt in the NuttX tools repository.
#

config EXAMPLES_API_ICCID
    tristate "api iccid example"
    default n
    ---help---
        Enable the api iccid example

if EXAMPLES_API_ICCID

config EXAMPLES_API_ICCID_PROGNAME
    string "Program name"
    default "api_iccid"

config EXAMPLES_API_ICCID_PRIORITY
    int "api iccid task priority"
    default 100

config EXAMPLES_API_ICCID_STACKSIZE
    int "api iccid stack size"
    default 2048

endif
```

## example/api_register_timeout/Kconfig
```kconfig
#
# For a description of the syntax of this configuration file,
# see the file kconfig-language.txt in the NuttX tools repository.
#

config EXAMPLES_API_REGISTER_TIMEOUT
    tristate "api register timeout example"
    default n
    ---help---
        Enable the api register timeout example

if EXAMPLES_API_REGISTER_TIMEOUT

config EXAMPLES_API_REGISTER_TIMEOUT_PROGNAME
    string "Program name"
    default "api_register_timeout"

config EXAMPLES_API_REGISTER_TIMEOUT_PRIORITY
    int "api register timeout task priority"
    default 100

config EXAMPLES_API_REGISTER_TIMEOUT_STACKSIZE
    int "api register timeout stack size"
    default 2048

endif
```

## example/api_setnbpwr/Kconfig
```kconfig
#
# For a description of the syntax of this configuration file,
# see the file kconfig-language.txt in the NuttX tools repository.
#

config EXAMPLES_API_SETNBPWR
    tristate "api set nb power example"
    default y
    ---help---
        Enable the api set nb power example

if EXAMPLES_API_SETNBPWR

config EXAMPLES_API_SETNBPWR_PROGNAME
    string "Program name"
    default "api_setnbpwr"

config EXAMPLES_API_SETNBPWR_PRIORITY
    int "api set nb power task priority"
    default 100

config EXAMPLES_API_SETNBPWR_STACKSIZE
    int "api set nb power stack size"
    default 2048

endif
```

## example/ceva_diag/Kconfig
```kconfig
#
# For a description of the syntax of this configuration file,
# see the file kconfig-language.txt in the NuttX tools repository.
#

config EXAMPLES_CEVA_DIAG
    tristate "ceva diag example"
    default n
    ---help---
        Enable the ceva diag example

if EXAMPLES_CEVA_DIAG

config EXAMPLES_CEVA_DIAG_PROGNAME
    string "Program name"
    default "ceva_diag"

config EXAMPLES_CEVA_DIAG_PRIORITY
    int "ceva diag task priority"
    default 100

config EXAMPLES_CEVA_DIAG_STACKSIZE
    int "ceva diag stack size"
    default 2048

endif
```

## example/codec2test/Kconfig
```kconfig
#
# For a description of the syntax of this configuration file,
# see the file kconfig-language.txt in the NuttX tools repository.
#
config CODEC2TEST
	bool "CODEC2TEST"
	default n
	---help---
	Enable the Codec2 test

if CODEC2TEST

config CODEC2TEST_STACKSIZE
	int "codec2 test task stack size"
	default 16384
	---help---
	The stack size allocated for the codec2test task.


config CODEC2TEST_PRIORITY
	int "codec2 test priority"
	default 100

endif # CODEC2TEST
```

## example/dstest/Kconfig
```kconfig
#
# For a description of the syntax of this configuration file,
# see the file kconfig-language.txt in the NuttX tools repository.
#

config DSTEST
	bool "DSTEST"
	default n
	select ARCH_CHIP_SONG
	---help---
	Enable the DSTEST

if DSTEST

config DSTEST_PRIORITY
	int "DSTEST config task priority"
	default 100

config DSTEST_STACKSIZE
	int "DSTEST config stack size"
	default 2048

endif
```

## example/fishdemo/Kconfig
```kconfig
#
# For a description of the syntax of this configuration file,
# see the file kconfig-language.txt in the NuttX tools repository.
#

config FISHDEMO
	bool "FISHDEMO"
	default n
	select FS_FAT
	select SCHED_WORKQUEUE
	select SIG_EVTHREAD
	select SCHED_LPWORK
	---help---
	Enable the FISHDEMO

if FISHDEMO

config FISHDEMO_PRIORITY
	int "FishDemo task priority"
	default 100

config FISHDEMO_STACKSIZE
	int "FishDemo stack size"
	default 2048

config FISHDEMO_AUTO_START
	bool "fishdemo auto start"
	default n
	---help---
	Start the fishdemo automatically.

endif
```

## example/flashwrtest/Kconfig
```kconfig
#
# For a description of the syntax of this configuration file,
# see the file kconfig-language.txt in the NuttX tools repository.
#

config FLASHWRTEST
	bool "FLASHWRTEST"
	default n
	select SERVICES_RIL
	---help---
		Enable the FLASHWRTEST

if FLASHWRTEST

config FLASHWRTEST_PRIORITY
	int "FLASHWRTEST task priority"
	default 100

config FLASHWRTEST_STACKSIZE
	int "FLASHWRTEST stack size"
	default 2048

endif
```

## example/gpiocfg/Kconfig
```kconfig
#
# For a description of the syntax of this configuration file,
# see the file kconfig-language.txt in the NuttX tools repository.
#

config GPIOCFG
	bool "GPIOCFG"
	default n
	select ARCH_CHIP_SONG
	select IOEXPANDER
	select DEV_GPIO
	select GPIO_LOWER_HALF
	select SONG_IOE
	---help---
	Enable the GPIOCFG

if GPIOCFG

config GPIOCFG_PRIORITY
	int "GPIO config task priority"
	default 100

config GPIOCFG_STACKSIZE
	int "GPIO config stack size"
	default 2048

endif
```

## example/gpiodemo/Kconfig
```kconfig
#
# For a description of the syntax of this configuration file,
# see the file kconfig-language.txt in the NuttX tools repository.
#

config GPIODEMO
	bool "GPIODEMO"
	default n
	select ARCH_CHIP_SONG
	select IOEXPANDER
	select DEV_GPIO
	select GPIO_LOWER_HALF
	select SONG_IOE
	select PINCTRL
	select SONG_PINCTRL
	---help---
	Enable the GPIODEMO

if GPIODEMO

config GPIODEMO_PRIORITY
	int "GPIO demo task priority"
	default 100

config GPIODEMO_STACKSIZE
	int "GPIO demo stack size"
	default 2048

endif
```

## example/gpstest/Kconfig
```kconfig
#
# For a description of the syntax of this configuration file,
# see the file kconfig-language.txt in the NuttX tools repository.
#

config GPSTEST
	bool "GPSTEST"
	default y
	select SERVICES_RIL
	select NETUTILS_PING if NET_ICMP_SOCKET
	select NETUTILS_PING6 if NET_ICMPv6_SOCKET
	---help---
	Enable the GPSTEST

if GPSTEST

config GPSTEST_PRIORITY
	int "gpstest task priority"
	default 80
	---help---
	The priority for gpstest task.

config GPSTEST_STACKSIZE
	int "gpstest task stack size"
	default 2048
	---help---
	The stack size allocated for the gpstest task.

config GPSTEST_AUTO_START
	bool "gpstest auto start"
	default n
	---help---
	Start the gpstest automatically.

endif # GPSTEST
```

## example/ota/Kconfig
```kconfig
#
# For a description of the syntax of this configuration file,
# see the file kconfig-language.txt in the NuttX tools repository.
#

config OTA
	bool "OTA"
	default n
	---help---
	Enable the OTA

if OTA

config OTA_PRIORITY
	int "ota task priority"
	default 80
	---help---
	The priority for ota task.

config OTA_STACKSIZE
	int "ota task stack size"
	default 2048
	---help---
	The stack size allocated for the ota task.

endif # OTA
```

## example/riltest/Kconfig
```kconfig
#
# For a description of the syntax of this configuration file,
# see the file kconfig-language.txt in the NuttX tools repository.
#
config RILTEST
	bool "RILTEST"
	default y
	select SERVICES_RIL
	---help---
	Enable the RILTEST

if RILTEST

config RILTEST_PRIORITY
	int "riltest task priority"
	default 80
	---help---
	The priority for riltest task.

config RILTEST_STACKSIZE
	int "riltest task stack size"
	default 2048
	---help---
	The stack size allocated for the riltest task.

config RILTEST_AUTO_START
	bool "riltest auto start"
	default n
	---help---
	Start the riltest automatically.

endif # RILTEST
```

## example/rtctest/Kconfig
```kconfig
#
# For a description of the syntax of this configuration file,
# see the file kconfig-language.txt in the NuttX tools repository.
#

config RTCTEST
	bool "RTCTEST"
	default n
	select SCHED_WORKQUEUE
	select SIG_EVTHREAD
	select SCHED_LPWORK
	---help---
	Enable the RTCTEST

if RTCTEST

config RTCTEST_PRIORITY
	int "RTCTest task priority"
	default 100

config RTCTEST_STACKSIZE
	int "RTCTest stack size"
	default 2048

endif
```

## example/sendatcmd/Kconfig
```kconfig
#
# For a description of the syntax of this configuration file,
# see the file kconfig-language.txt in the NuttX tools repository.
#
config SENDATCMD
	bool "SENDATCMD"
	default n
	select SERVICES_RIL
	---help---
	Enable the SENDATCMD

if SENDATCMD

config SENDATCMD_PRIORITY
	int "sendatcmd task priority"
	default 80
	---help---
	The priority for sendatcmd task.

config SENDATCMD_STACKSIZE
	int "sendatcmd task stack size"
	default 2048
	---help---
	The stack size allocated for the sendatcmd task.

endif # SENDATCMD
```

## example/tcptest/Kconfig
```kconfig
#
# For a description of the syntax of this configuration file,
# see the file kconfig-language.txt in the NuttX tools repository.
#

config TCPTEST
	bool "TCPTEST"
	default n
	select SERVICES_RIL
	select NETUTILS_PING if NET_ICMP_SOCKET
	select NETUTILS_PING6 if NET_ICMPv6_SOCKET
	---help---
	Enable the TCPTEST

if TCPTEST

config TCPTEST_PRIORITY
	int "tcptest task priority"
	default 80
	---help---
	The priority for tcptest task.

config TCPTEST_STACKSIZE
	int "tcptest task stack size"
	default 2048
	---help---
	The stack size allocated for the tcptest task.

config TCPTEST_AUTO_START
	bool "tcptest auto start"
	default n
	---help---
	Start the tcptest automatically.

endif # TCPTEST

if TCPTEST_AUTO_START

config TCPTEST_REMOTE_IP
	string "tcptest remote ip address"
	default ""
	---help---
	The remote ip address to communicate.

config TCPTEST_REMOTE_PORT
	int "tcptest remote port"
	default 0
	---help---
	The remote port to communicate.

endif # TCPTEST_AUTO_START
```

## example/tws_e2/Kconfig
```kconfig
#
# For a description of the syntax of this configuration file,
# see the file kconfig-language.txt in the NuttX tools repository.
#

config EXAMPLES_TWS_E2
    tristate "tws e2 example"
    default y
    ---help---
        Enable the tws e2 example

if EXAMPLES_TWS_E1

config EXAMPLES_TWS_E2_PROGNAME
    string "Program name"
    default "tws_e2"

config EXAMPLES_TWS_E2_PRIORITY
    int "tws e1 task priority"
    default 100

config EXAMPLES_TWS_E2_STACKSIZE
    int "tws e1 stack size"
    default 2048

endif
```

## example/tws_m2/Kconfig
```kconfig
#
# For a description of the syntax of this configuration file,
# see the file kconfig-language.txt in the NuttX tools repository.
#

config EXAMPLES_TWS_M2
    tristate "tws m2 example"
    default y
    ---help---
        Enable the TWS M2 example

if EXAMPLES_TWS_M2

config EXAMPLES_TWS_M2_PROGNAME
    string "Program name"
    default "tws_m2"

config EXAMPLES_TWS_M2_PRIORITY
    int "tws m2 task priority"
    default 100

config EXAMPLES_TWS_M2_STACKSIZE
    int "tws m2 stack size"
    default 2048

endif
```

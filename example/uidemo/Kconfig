## example/uidemo/Kconfig
```kconfig
#
# For a description of the syntax of this configuration file,
# see the file kconfig-language.txt in the NuttX tools repository.
#

menuconfig EXAMPLES_UIDEMO
	tristate "UI Library Demo"
	default n
	---help---
		Enable build the UI Library Demo programs

if EXAMPLES_UIDEMO

config EXAMPLES_UIDEMO_PRIORITY
	int "ui task priority"
	default 100

config EXAMPLES_UIDEMO_STACKSIZE
	int "uidemo stack size"
	default 16384

endif
```

## example/uzlib/Kconfig
```kconfig
#
# For a description of the syntax of this configuration file,
# see the file kconfig-language.txt in the NuttX tools repository.
#
config UZLIB
	bool "UZLIB"
	default n
	---help---
	Enable the uzlib test

if UZLIB

config UZLIB_STACKSIZE
	int "uzlib test task stack size"
	default 16384
	---help---
	The stack size allocated for the UZLIB task.


config UZLIB_PRIORITY
	int "uzlib test priority"
	default 100

endif # UZLIB
```

## example/vbattest/Kconfig
```kconfig
#
# For a description of the syntax of this configuration file,
# see the file kconfig-language.txt in the NuttX tools repository.
#

config VBATTEST
	bool "VBATTEST"
	default n
	select SERVICES_RIL
	---help---
	Enable the VBATTEST

if VBATTEST

config VBATTEST_PRIORITY
	int "VBATTest task priority"
	default 100

config VBATTEST_STACKSIZE
	int "VBATTest stack size"
	default 2048

endif
```

## frameworks/Kconfig
```kconfig
#
# For a description of the syntax of this configuration file,
# see kconfig-language at https://www.kernel.org/doc/Documentation/kbuild/kconfig-language.txt
#

menu "Frameworks"

config FRAMEWORKS
    bool "Enable Frameworks"
    default n
    ---help---
        Enable Frameworks

endmenu # FRAMEWORKS
```

## isp/isp_firmware/Kconfig
```kconfig
#
# For a description of the syntax of this configuration file,
# see the file kconfig-language.txt in the NuttX tools repository.
#

config ISP_FIRMWARE
    bool "isp firmware"
    default n
    ---help---
        ISP firmware for v1

config ISP_SIMPLE_HOST
	bool "isp simple host"
	default n

if ISP_FIRMWARE

config ISP_FIRMWARE_PROGNAME
    string "Program name"
    default "isp_firmware"

config ISP_FIRMWARE_PRIORITY
    int "isp firmware task priority"
    default 100

config ISP_FIRMWARE_STACKSIZE
    int "isp firmware stack size"
    default 2048

endif
```

## isp/isp_hello/Kconfig
```kconfig
#
# For a description of the syntax of this configuration file,
# see the file kconfig-language.txt in the NuttX tools repository.
#

config ISP_HELLO
    bool "isp hello"
    default n
    ---help---
        Enable the api gpio example

if ISP_HELLO

config ISP_HELLO_PROGNAME
    string "Program name"
    default "isp_hello"

config ISP_HELLO_PRIORITY
    int "isp hello task priority"
    default 100

config ISP_HELLO_STACKSIZE
    int "isp hello stack size"
    default 2048

endif
```

## isp/isp_simple_host/Kconfig
```kconfig
#
# For a description of the syntax of this configuration file,
# see the file kconfig-language.txt in the NuttX tools repository.
#

config ISP_SIMPLE_HOST
    bool "isp simple host"
    default n
    ---help---
        Enable the api isp simple host

if ISP_SIMPLE_HOST

config ISP_SIMPLE_HOST_PROGNAME
    string "Program name"
    default "isp_simple_host"

config ISP_SIMPLE_HOST_PRIORITY
    int "isp simple host task priority"
    default 100

config ISP_SIMPLE_HOST_STACKSIZE
    int "isp simple host stack size"
    default 2048

endif
```

## isp/isp_verify_intr/Kconfig
```kconfig
#
# For a description of the syntax of this configuration file,
# see the file kconfig-language.txt in the NuttX tools repository.
#

config ISP_VERIFY_INTR
    bool "isp verify intr"
    default n
    ---help---
        Enable the api isp verify intr

if ISP_VERIFY_INTR

config ISP_VERIFY_INTR_PROGNAME
    string "Program name"
    default "isp_verify_intr"

config ISP_VERIFY_INTR_PRIORITY
    int "isp verify intr task priority"
    default 100

config ISP_VERIFY_INTR_STACKSIZE
    int "isp verify intr stack size"
    default 2048

endif
```

## services/audio/Kconfig
```kconfig
#
# For a description of the syntax of this configuration file,
# see the file kconfig-language.txt in the NuttX tools repository.
#

config AUDIO_SERVICE
	tristate "Audio Service"
	default n
	---help---
		Enable Audio Service.

if AUDIO_SERVICE

config AUDIO_DAEMON
	bool "Enable AUDIO DAEMON"
	default n
	---help---
		Enable Audio Daemon.

endif # AUDIO_SERVICE
```
